## br-ext-chip-hisilicon/configs/hi3516cv6xx_waybeam_lite_defconfig
```kconfig
# OpenIPC
BR2_OPENIPC_SOC_VENDOR="hisilicon"
BR2_OPENIPC_SOC_MODEL="hi3516cv6xx"
BR2_OPENIPC_SOC_FAMILY="hi3516cv6xx"
BR2_OPENIPC_SOC_ALIASES="hi3516cv610 hi3516cv608"
BR2_OPENIPC_VARIANT="waybeam_lite_fpv"
BR2_OPENIPC_FLASH_SIZE="16"

# waybeam_lite — a development image for bringing up new sensors and writing a
# VENC streamer on cv6xx, not a product image. Relative to _ultimate it drops
# every end-user application (majestic and its webui/fonts, divinus, aws-webrtc,
# motors, vtund, zerotier, mosquitto, uacme, quirc) plus the libraries that
# exist only to satisfy them (libwebsockets, libevent, protobuf-c, jsonfilter),
# and the network plumbing an FPV air unit does not use (iptables, wireguard).
# In exchange it carries the tools you actually reach for when a sensor will not
# stream: gdbserver, iperf3, and iw. Strace and tcpdump stay out so the FPV
# image remains compatible with the factory 6 MiB rootfs partition.
#
# The vendor MPP .so set and the source-built sensor drivers are untouched — the
# point of this variant is to have MPP and nothing else in the way.

# Architecture
BR2_arm=y
BR2_cortex_a7=y
BR2_ARM_EABI=y
BR2_ARM_FPU_NEON_VFPV4=y
BR2_ARM_INSTRUCTIONS_THUMB2=y

# Toolchain
BR2_TOOLCHAIN_EXTERNAL=y
BR2_TOOLCHAIN_EXTERNAL_DOWNLOAD=y
BR2_TOOLCHAIN_EXTERNAL_URL="https://github.com/openipc/firmware/releases/download/$(OPENIPC_TOOLCHAIN).tgz"
BR2_TOOLCHAIN_EXTERNAL_CUSTOM_PREFIX="arm-openipc-linux-musleabi"
BR2_TOOLCHAIN_EXTERNAL_HEADERS_5_10=y
BR2_TOOLCHAIN_EXTERNAL_CUSTOM_MUSL=y
BR2_GCC_VERSION_13_X=y
BR2_TOOLCHAIN_EXTERNAL_CXX=y

# Kernel
BR2_LINUX_KERNEL=y
BR2_LINUX_KERNEL_CUSTOM_TARBALL=y
BR2_LINUX_KERNEL_CUSTOM_TARBALL_LOCATION="https://github.com/openipc/linux/archive/$(OPENIPC_KERNEL).tar.gz"
BR2_LINUX_KERNEL_USE_CUSTOM_CONFIG=y
BR2_LINUX_KERNEL_CUSTOM_CONFIG_FILE="$(EXTERNAL_VENDOR)/board/$(OPENIPC_SOC_FAMILY)/$(BR2_OPENIPC_SOC_MODEL).generic.config"
BR2_ROOTFS_POST_IMAGE_SCRIPT="$(EXTERNAL_VENDOR)/board/$(OPENIPC_SOC_FAMILY)/post-image.sh"
BR2_LINUX_KERNEL_ZIMAGE=y
BR2_LINUX_KERNEL_XZ=y
BR2_LINUX_KERNEL_UIMAGE_LOADADDR="0x40018000"
BR2_LINUX_KERNEL_DTS_SUPPORT=y
# BR2_LINUX_KERNEL_DTB_IS_SELF_BUILT is not set
BR2_LINUX_KERNEL_INTREE_DTS_NAME="hi3516cv610-demb"

# Filesystem
BR2_PACKAGE_BUSYBOX_CONFIG="$(BR2_EXTERNAL)/package/busybox/busybox.config"
# uboot-tools provides fw_printenv/fw_setenv. load_hisilicon reads the OS/MMZ
# memory split from the u-boot env through it, so this is not optional here.
BR2_PACKAGE_UBOOT_TOOLS=y
# BR2_PACKAGE_IFUPDOWN_SCRIPTS is not set
BR2_TARGET_ROOTFS_SQUASHFS=y
BR2_TARGET_ROOTFS_SQUASHFS4_XZ=y

# Packages — platform
BR2_PACKAGE_DROPBEAR_OPENIPC=y
BR2_PACKAGE_HISILICON_OPENSDK=y
BR2_PACKAGE_HISILICON_OSDRV_HI3516CV6XX=y
BR2_PACKAGE_CV610_STREAMER=y
BR2_PACKAGE_RTL8733BU_OPENIPC=y
BR2_PACKAGE_IPCTOOL=y
BR2_PACKAGE_YAML_CLI=y
BR2_PACKAGE_LIBCURL_OPENIPC_CURL=y
# BR2_PACKAGE_LIBCURL_OPENIPC_PROXY_SUPPORT is not set
# BR2_PACKAGE_LIBCURL_OPENIPC_COOKIES_SUPPORT is not set
# BR2_PACKAGE_LIBCURL_OPENIPC_EXTRA_PROTOCOLS_FEATURES is not set
# libss_mpi_audio_adp.so has libopus.so in DT_NEEDED and calls six HiSi-only
# ot_opus_* entry points; opus-openipc's HISI_SHIM supplies both. Kept even
# though no audio application ships here, so that dlopen()ing the MPP audio
# libs from test code does not fail on a missing symbol.
BR2_PACKAGE_OPUS_OPENIPC=y
BR2_PACKAGE_OPUS_OPENIPC_FIXED_POINT=y
BR2_PACKAGE_OPUS_OPENIPC_HISI_SHIM=y

# Packages — bringup and streamer development
# i2c{detect,get,set,dump,transfer} and devmem come from the busybox config
# above, so sensor probing and register pokes need no extra package.
BR2_PACKAGE_GDBSERVER_LITE=y
BR2_PACKAGE_IPERF3=y
BR2_PACKAGE_IW=y
```

## general/package/cv610-streamer/Config.in
```kconfig
config BR2_PACKAGE_CV610_STREAMER
	bool "cv610-streamer"
	depends on BR2_PACKAGE_HISILICON_OPENSDK
	depends on BR2_PACKAGE_HISILICON_OSDRV_HI3516CV6XX
	help
	  Lightweight IMX662 -> VI -> ISP -> H.265 CBR -> RTP proof of
	  concept for Hi3516CV610. This development package also installs a
	  configurable init service that streams continuously after boot.

	  https://github.com/snokvist/hi3519dv500-openipc-venc
```
