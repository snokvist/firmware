## general/package/waybeam/Config.in
```kconfig
config BR2_PACKAGE_WAYBEAM
	bool "waybeam"
	depends on BR2_TOOLCHAIN_HAS_THREADS
	depends on !BR2_PACKAGE_MAJESTIC
	depends on BR2_PACKAGE_SIGMASTAR_OSDRV_INFINITY6E || (BR2_PACKAGE_HISILICON_OPENSDK && BR2_PACKAGE_HISILICON_OSDRV_HI3516CV6XX && BR2_PACKAGE_OPUS_OPENIPC)
	help
	  Standalone Waybeam H.265 video encoder and streamer.

	  The package supports SigmaStar Infinity6E and HiSilicon CV610.
	  The CV610 backend includes Waybeam's integrated IMX662 sensor
	  driver and uses the CV610-specific MPP registration shim.

	  It is an alternative to the Majestic streamer and cannot be
	  built alongside it.

	  https://github.com/OpenIPC/waybeam
```
